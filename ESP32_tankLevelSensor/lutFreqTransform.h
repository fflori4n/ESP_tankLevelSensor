double lut1Outputmms = 0;
double lut2Outputmms = 0;
const double freq2mmsLUT[] = {
15000  , 8000  ,
16700 , 7184  ,
16700 , 7168  ,
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95630 , 0 ,
 
};
const double mms2correctedmmsLUT[] = {
  3200 , 0 ,
  3450, 50  ,
  3725 , 100 ,
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  6950,1040
};

double getLUTmms(double in, const bool correction, bool verboseFlag = true) {
  double out = -999;

  if ( in < 1) {      /// if sensor reads 0Hz, probe is not connected or faulty, return error
    return -999;      /// return negative num. to signal no con error - TODO: handle this in liquidLevel.h
  }

  int lutLen = sizeof(freq2mmsLUT) / sizeof(freq2mmsLUT[0]);

  if (in >= freq2mmsLUT[(lutLen - 2)]) { /// check if LUT contains in
    out = freq2mmsLUT[(lutLen - 1)];
  } else if (in < freq2mmsLUT[0]) {
    out = freq2mmsLUT[1];
  } else {
    for (int i = 0; i < lutLen - 2; i += 2) {                               /// Loop over LUT, get two points next to each other
      if (in > freq2mmsLUT[i] && in <= freq2mmsLUT[ i + 2 ]) {               /// if measured value is between the two points
        double percent = (in - freq2mmsLUT[i]) / (freq2mmsLUT[i + 2] - freq2mmsLUT[i]);
        out = freq2mmsLUT[ i + 1 ] + ((freq2mmsLUT[ i + 3 ] - freq2mmsLUT[ i + 1 ]) * percent);
        break;
      }
    }
  }

  if (!correction) {
    if (verboseFlag) {
      Serial.println("Freq -> mm's");
      Serial.print("Freq:\t\t");
      Serial.print(in);
      Serial.print(" LUT Out:\t\t");
      Serial.println(out);
    }

    return out;
  }

  if (verboseFlag) {
      Serial.println("Freq -> mm's");
      Serial.print("Freq:\t\t");
      Serial.print(in);
      Serial.print(" LUT Out:\t\t");
      Serial.println(out);
  }
  lut1Outputmms = out;
  in=out;
  lutLen = sizeof(mms2correctedmmsLUT) / sizeof(mms2correctedmmsLUT[0]);

  if (in >= mms2correctedmmsLUT[(lutLen - 2)]) { /// check if LUT contains in
    out = mms2correctedmmsLUT[(lutLen - 1)];
  } else if (in < mms2correctedmmsLUT[0]) {
    out = mms2correctedmmsLUT[1];
  } else {
    for (int i = 0; i < lutLen - 2; i += 2) {                               /// Loop over LUT, get two points next to each other
      if (in > mms2correctedmmsLUT[i] && in <= mms2correctedmmsLUT[ i + 2 ]) {               /// if measured value is between the two points
        double percent = (in - mms2correctedmmsLUT[i]) / (mms2correctedmmsLUT[i + 2] - mms2correctedmmsLUT[i]);
        out = mms2correctedmmsLUT[ i + 1 ] + ((mms2correctedmmsLUT[ i + 3 ] - mms2correctedmmsLUT[ i + 1 ]) * percent);
        break;
      }
    }
  }

  if (verboseFlag) {
      Serial.println("mm's -> corrected");
      Serial.print("mm:\t\t");
      Serial.print(in);
      Serial.print(" LUT Out:\t\t");
      Serial.println(out);
  }

  lut2Outputmms = out;
  return out;
}
